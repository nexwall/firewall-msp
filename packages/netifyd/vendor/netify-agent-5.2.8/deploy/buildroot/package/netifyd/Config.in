## packages/netifyd/vendor/netify-agent-5.2.8/deploy/buildroot/package/netifyd/Config.in
```kconfig
menuconfig BR2_PACKAGE_NETIFYD
	bool "netifyd"
	depends on BR2_USE_MMU
	depends on BR2_INSTALL_LIBSTDCPP
	select BR2_PACKAGE_CA_CERTIFICATES
	select BR2_PACKAGE_OPENSSL
	select BR2_PACKAGE_LIBCURL
	select BR2_PACKAGE_LIBCURL_OPENSSL
	select BR2_PACKAGE_LIBPCAP
	select BR2_PACKAGE_ZLIB
	help
	  The Netify Agent is a deep-packet inspection server.

	  The Agent is built on top of nDPI (formerly OpenDPI).

	  See the following website for more information:
	  http://www.netify.ai/

if BR2_PACKAGE_NETIFYD

comment "Capture Sources"

config BR2_PACKAGE_NETIFYD_TPACKETV3
	bool "TPACKETv3 support"
	default y
	help
	  Enable TPACKETv3 capture support.

config BR2_PACKAGE_NETIFYD_NFQUEUE
	bool "NFQUEUE support"
	default n
	select BR2_PACKAGE_LIBNETFILTER_QUEUE
	select BR2_PACKAGE_LIBNETFILTER_CONNTRACK
	help
	  Enable NFQUEUE capture support.

comment "Conntrack Options"

config BR2_PACKAGE_NETIFYD_CONNTRACK
	bool "conntrack support"
	default y
	select BR2_PACKAGE_LIBNETFILTER_CONNTRACK
	help
	  Enable connection tracking support for NAT detection.

if BR2_PACKAGE_NETIFYD_CONNTRACK

config BR2_PACKAGE_NETIFYD_CONNTRACK_MDATA
	bool "extract conntrack metadata"
	default n
	help
	  Enable connection tracking support for NAT detection.

endif

comment "General Options"

config BR2_PACKAGE_NETIFYD_NETLINK
	bool "netlink support"
	default y
	help
	  Enable dynamic interface configuration messaging via Netlink.

config BR2_PACKAGE_NETIFYD_EXTENDED_STATS
	bool "enable extended statistics"
	default y
	help
	  Enable extra per-flow statistics such as the number of TCP resets, sequence errors, etc.

config BR2_PACKAGE_NETIFYD_LEAN_AND_MEAN
	bool "enable lean-and-mean build"
	default n
	help
	  Enabling lean-and-mean build disables as many extra features as possible to produce the smallest binary.

config BR2_PACKAGE_NETIFYD_UBUS
	bool "UBUS support"
	default n
	select BR2_PACKAGE_UBUS
	help
	  Enable UBUS support.

endif

comment "The Netify Agent requires a Toolchain with C++11 support"
	depends on !BR2_INSTALL_LIBSTDCPP

comment "The Netify Agent requires libCURL with TLS support"
	depends on !BR2_PACKAGE_OPENSSL
	depends on !BR2_PACKAGE_LIBCURL
	depends on !BR2_PACKAGE_LIBCURL_OPENSSL
	depends on BR2_PACKAGE_LIBCURL_TLS_NONE
```
